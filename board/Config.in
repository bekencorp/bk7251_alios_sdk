## board/Config.in
```kconfig
menu "BSP         Configuration"
choice
    prompt "Board Selection"

source "board/bk7251devkitc/Config.in"
if AOS_BOARD_BK7251
    config AOS_BUILD_BOARD
        default "bk7251devkitc"

    source "platform/mcu/bk7251/Config.in"
    source "platform/arch/arm/armv5/Config.in"
endif

endchoice

endmenu
```

## board/bk7251devkitc/Config.in
```kconfig
config AOS_BOARD_BK7251
    bool "BK7251"
    select AOS_MCU_BK7251
    select AOS_COMP_KERNEL_INIT
    help
      configuration for board bk7251

if AOS_BOARD_BK7251
# Configurations for board board_bk7251

# "BSP SUPPORT FEATURE"
config BSP_SUPPORT_UART
    bool
    default y

config BSP_SUPPORT_GPIO
    bool
    default y

config BSP_SUPPORT_FLASH
    bool
    default y

config BSP_SUPPORT_TIMER
    bool
    default y

config BSP_SUPPORT_WDG
    bool
    default y

config BSP_SUPPORT_WIFI
    bool
    default y

endif
```
